## config/boards/shields/corne/Kconfig.shield
```kconfig
config SHIELD_CORNE
    bool

config SHIELD_CORNE_LEFT
    def_bool $(shields_list_contains,corne_left)
        select SHIELD_CORNE

config SHIELD_CORNE_RIGHT
    def_bool $(shields_list_contains,corne_right)
        select SHIELD_CORNE
```
