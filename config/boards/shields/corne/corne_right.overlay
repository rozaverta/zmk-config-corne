#include "corne.dtsi"

&default_transform {
	col-offset = <6>;
};

&kscan0 {
	col-gpios
		= <&pro_micro_d 14 (GPIO_ACTIVE_HIGH | GPIO_PULL_DOWN)>
		, <&pro_micro_d 15 (GPIO_ACTIVE_HIGH | GPIO_PULL_DOWN)>
		, <&pro_micro_a 18 (GPIO_ACTIVE_HIGH | GPIO_PULL_DOWN)>
		, <&pro_micro_a 19 (GPIO_ACTIVE_HIGH | GPIO_PULL_DOWN)>
		, <&pro_micro_a 20 (GPIO_ACTIVE_HIGH | GPIO_PULL_DOWN)>
		, <&pro_micro_a 21 (GPIO_ACTIVE_HIGH | GPIO_PULL_DOWN)>
		;
};